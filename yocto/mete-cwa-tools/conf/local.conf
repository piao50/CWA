## yocto/mete-cwa-tools/conf/local.conf
```bitbake
# We have a conf and classes directory, add to BBPATH
BBPATH .= ":${LAYERDIR}"

# We have a packages directory, add to BBFILES
BBFILES += "${LAYERDIR}/recipes-*/*/*.bb \
            ${LAYERDIR}/recipes-*/*/*.bbappend"

BBFILE_COLLECTIONS += "cwa-tools"
BBFILE_PATTERN_cwa-tools := "^${LAYERDIR}/"
BBFILE_PRIORITY_cwa-tools = "6"
```
